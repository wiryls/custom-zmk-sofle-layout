## boards/shields/custom_sofle/Kconfig.shield
```kconfig
# Copyright (c) 2020 The ZMK Contributors
# SPDX-License-Identifier: MIT

config SHIELD_CUSTOM_SOFLE_LEFT
    def_bool $(shields_list_contains,custom_sofle_left)

config SHIELD_CUSTOM_SOFLE_RIGHT
    def_bool $(shields_list_contains,custom_sofle_right)
```
